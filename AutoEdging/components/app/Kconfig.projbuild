## AutoEdging/components/app/Kconfig.projbuild
```kconfig
menu "App Configuration"

config APP_WIFI_SSID
    string "Wi-Fi SSID"
    default ""

config APP_WIFI_PASSWORD
    string "Wi-Fi Password"
    default ""

config APP_WIFI_MAX_RETRY
    int "Wi-Fi Max Retry"
    default 10

config APP_MDNS_HOSTNAME
    string "mDNS Hostname"
    default "autoedging"

config APP_DEBUG_IO
    bool "Enable IO debug logs"
    default n

endmenu
```

## AutoEdging/sdkconfig.defaults
```kconfig
CONFIG_BT_ENABLED=y
CONFIG_I2C_ENABLE_SLAVE_DRIVER_VERSION_2=y
CONFIG_PARTITION_TABLE_CUSTOM=y
CONFIG_PARTITION_TABLE_FILENAME="partitions.csv"
CONFIG_HTTPD_WS_SUPPORT=y

# PSRAM Configuration
CONFIG_SPIRAM=y
CONFIG_SPIRAM_MODE_OCT=y
CONFIG_SPIRAM_TYPE_AUTO=y
CONFIG_SPIRAM_SPEED_80M=y
CONFIG_SPIRAM_USE_MALLOC=y
CONFIG_SPIRAM_MALLOC_ALWAYSINTERNAL=65536
CONFIG_SPIRAM_ALLOW_BSS_SEG_EXTERNAL_MEMORY=y

# Memory optimizations
CONFIG_COMPILER_OPTIMIZATION_SIZE=y
```

## firmware/components/app/Kconfig.projbuild
```kconfig
menu "App Configuration"

config APP_WIFI_MAX_RETRY
    int "Wi-Fi Max Retry"
    default 10

config APP_WIFI_PROV_POP
    string "BLE Provisioning Proof-of-Possession"
    default "AE123"

config APP_WIFI_PROV_SERVICE_PREFIX
    string "BLE Provisioning Device Name Prefix"
    default "PROV_AutoEdging_"

config APP_MDNS_HOSTNAME
    string "mDNS Hostname"
    default "autoedging"

config APP_DEBUG_IO
    bool "Enable IO debug logs"
    default n

config APP_MEMORY_LOG_ENABLE
    bool "Enable periodic memory usage logs"
    default n

endmenu
```
